#include "tile.dtsi"

&default_transform {
    col-offset = <5>;
};

&kscan0 {
    col-gpios
        // Odwrócona kolejność pinów z tile.dtsi (od inner do pinky)
        = <&gpio0 17 GPIO_ACTIVE_HIGH> // inner (P017)
        , <&gpio1 4 GPIO_ACTIVE_HIGH>  // index (P104)
        , <&gpio1 6 GPIO_ACTIVE_HIGH>  // middle (P106)
        , <&gpio0 8 GPIO_ACTIVE_HIGH>  // ring (P008)
        , <&gpio0 6 GPIO_ACTIVE_HIGH>  // pinky (P006)
        ;
};