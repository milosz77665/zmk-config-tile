## config/boards/shields/Kconfig.shield
```kconfig
config SHIELD_TILE_LEFT
    def_bool $(shields_list_contains,tile_left)

config SHIELD_TILE_RIGHT
    def_bool $(shields_list_contains,tile_right)
```

## config/boards/shields/tile/Kconfig.defconfig
```kconfig
if SHIELD_TILE_LEFT

config ZMK_KEYBOARD_NAME
    default "Tile Keyboard"

config ZMK_SPLIT_ROLE_CENTRAL
    default y

endif

if SHIELD_TILE_LEFT || SHIELD_TILE_RIGHT

config ZMK_SPLIT
    default y

endif
```
